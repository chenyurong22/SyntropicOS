/**
 * @file main.c
 * @brief SyntropicOS ISO 15765-2 (ISO-TP) & UDS (ISO 14229) STM32 HAL Integration Example.
 *
 * Demonstrates non-blocking, zero-malloc ISO-TP multi-frame CAN transport integrated
 * with syn_uds server, including automatic VIN DID responses and deferred 0x11 ECU reset.
 */

#include "syntropic/proto/syn_isotp.h"
#include "syntropic/proto/syn_uds.h"
#include "syntropic/syntropic.h"
#include "stm32f4xx_hal.h"  /* Or stm32f1xx_hal.h / stm32g4xx_hal.h depending on target MCU */

/* Hardware CAN handle instance */
extern CAN_HandleTypeDef hcan1;

/* Static ISO-TP Link and UDS Server (zero dynamic allocation) */
static SYN_ISOTP_Link isotp_link;
static SYN_UDS_Server uds_server;

static uint8_t rx_buffer[512];
static uint8_t tx_buffer[512];
static uint8_t vin_data[] = "SYNTROPICOS1234567";

/**
 * @brief Initialize ISO-TP link and UDS diagnostic server.
 */
void isotp_app_init(void)
{
    /*
     * Initialize link for ECU Diagnostic Server:
     *   - Rx CAN ID: 0x7E0 (incoming UDS request from diagnostic tester)
     *   - Tx CAN ID: 0x7E8 (outgoing UDS response to diagnostic tester)
     */
    syn_isotp_init(&isotp_link, 0x7E0, 0x7E8,
                   rx_buffer, sizeof(rx_buffer),
                   tx_buffer, sizeof(tx_buffer));

    /* Configure network layer timeouts (N_Bs = 1000ms, N_Cr = 1000ms) */
    syn_isotp_set_timeouts(&isotp_link, 1000, 1000);

    /* Initialize UDS Server and register VIN DID (0xF190) */
    syn_uds_init(&uds_server);
    syn_uds_register_did(&uds_server, 0xF190, vin_data, sizeof(vin_data) - 1, false);
}

/**
 * @brief STM32 HAL CAN Rx FIFO 0 Interrupt Callback.
 *
 * Invoked by STM32 HAL whenever a raw CAN frame arrives on FIFO 0.
 * Ingests raw frame into SyntropicOS ISO-TP engine.
 */
void HAL_CAN_RxFifo0MsgPendingCallback(CAN_HandleTypeDef *hcan)
{
    if (hcan->Instance == CAN1) {
        CAN_RxHeaderTypeDef rx_hdr;
        SYN_CAN_Frame frame;

        if (HAL_CAN_GetRxMessage(hcan, CAN_RX_FIFO0, &rx_hdr, frame.data) == HAL_OK) {
            frame.id  = (rx_hdr.IDE == CAN_ID_STD) ? rx_hdr.StdId : rx_hdr.ExtId;
            frame.dlc = (uint8_t)rx_hdr.DLC;
#if defined(SYN_USE_CAN_FD) && SYN_USE_CAN_FD
            frame.is_fd = false;
#endif
            /* Feed frame into ISO-TP state machine */
            syn_isotp_process_rx_frame(&isotp_link, &frame);
        }
    }
}

/**
 * @brief Main application loop / task routine.
 *
 * Called periodically in main while(1) loop or scheduler task.
 */
void isotp_app_loop(uint32_t dt_ms)
{
    /* 1. Step ISO-TP and UDS timers */
    syn_isotp_step(&isotp_link, dt_ms);
    syn_uds_tick(&uds_server, dt_ms);

    /* 2. Drain and transmit all pending outgoing CAN frames generated by ISO-TP */
    SYN_CAN_Frame tx_frame;
    while (syn_isotp_get_tx_frame(&isotp_link, &tx_frame)) {
        CAN_TxHeaderTypeDef tx_hdr = {0};
        tx_hdr.StdId = tx_frame.id;
        tx_hdr.IDE   = CAN_ID_STD;
        tx_hdr.RTR   = CAN_RTR_DATA;
        tx_hdr.DLC   = tx_frame.dlc;

        uint32_t tx_mailbox;
        HAL_CAN_AddTxMessage(&hcan1, &tx_hdr, tx_frame.data, &tx_mailbox);
    }

    /* 3. Check if a complete assembled ISO-TP request message has arrived */
    uint8_t req_payload[256];
    ssize_t len = syn_isotp_receive(&isotp_link, req_payload, sizeof(req_payload));
    if (len > 0) {
        uint8_t resp_payload[256];
        uint16_t resp_len = 0;

        /* Process request through UDS diagnostic server */
        if (syn_uds_process_request(&uds_server, req_payload, (uint16_t)len, resp_payload,
                                    sizeof(resp_payload), &resp_len, SYN_UDS_ADDR_PHYSICAL)) {
            /* Transmit UDS response payload back over ISO-TP link */
            syn_isotp_send(&isotp_link, resp_payload, resp_len);
        }
    }

    /* 4. Execute deferred 0x11 ECU reset AFTER response frames complete transmission */
    uint8_t reset_type = syn_uds_get_pending_reset(&uds_server);
    if (reset_type > 0 && syn_isotp_is_tx_idle(&isotp_link)) {
        syn_uds_clear_pending_reset(&uds_server);
        NVIC_SystemReset();
    }
}
